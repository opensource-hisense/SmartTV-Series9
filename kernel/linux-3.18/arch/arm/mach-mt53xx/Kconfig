## kernel/linux-3.18/arch/arm/mach-mt53xx/Kconfig
```kconfig
# arch/arm/plat-mt53xx/Kconfig
#
# by lh.hsiao
#
# Licensed under GPLv2


if PLAT_MT53XX
# boot configurations
choice
	prompt "ARCH/MACH select"
default MACH_MT5398

config MACH_MT5368
	bool "MediaTek MT5368(Cortex-A9 single-core)"
	select CPU_V7
	select ARM_GIC
        select MIGHT_HAVE_CACHE_L2X0
	select ARCH_MT5368
	select CACHE_L2X0
	select CACHE_PL310
	help
	  This enables support for MediaTek MT5368.

config MACH_MT5396
	bool "MediaTek MT5396(Cortex-A9 dual-core)"
	select CPU_V7
	select ARM_GIC
	select HAVE_SMP
        select MIGHT_HAVE_CACHE_L2X0
	select ARCH_MT5396
	select NEED_PREPARE_CPUS_FOR_ONE
	select CACHE_L2X0
	select CACHE_PL310
	help
	  This enables support for MediaTek MT5396.

config MACH_MT5369
	bool "MediaTek MT5369(Cortex-A9 single-core)"
	select CPU_V7
	select ARM_GIC
        select MIGHT_HAVE_CACHE_L2X0
	select ARCH_MT5396	       	# Share code with MT5396
	select MT53XX_UP_CHECK
	select CACHE_L2X0
	select CACHE_PL310
	help
	  This enables support for MediaTek MT5369.

config MACH_MT5389
	bool "MediaTek MT5389(Arm11)"
	select CPU_V6
	select CPU_32v6K
        select MIGHT_HAVE_CACHE_L2X0
	select ARCH_MT5389
	select CACHE_L2X0
	select CACHE_PL310
	help
	  This enables support for MediaTek MT5389.

config MACH_MT5398
	bool "MediaTek MT5398(Cobra Cortex-A9 dual-core)"
	select CPU_V7
	select ARM_GIC
	select HAVE_SMP
        select MIGHT_HAVE_CACHE_L2X0
	select ARCH_MT5398
	select NEED_PREPARE_CPUS_FOR_ONE if SMP
	select MT53XX_UP_CHECK if !SMP
	help
	  This enables support for MediaTek MT5398.

config MACH_MT5399
	bool "MediaTek MT5399(Cobra Cortex-A9 dual-core)"
	select CPU_V7
	select ARM_GIC
	select HAVE_SMP
        select MIGHT_HAVE_CACHE_L2X0
	select ARCH_MT5399
	select NEED_PREPARE_CPUS_FOR_ONE if SMP
	select MT53XX_UP_CHECK if !SMP
	help
	  This enables support for MediaTek MT5399.

config MACH_MT5886
    bool "MediaTek MT5886(Oryx Cortex-A53 quad-core)"
    select CPU_V7
    select ARM_GIC
    select HAVE_SMP
    select ARCH_MT5886
    select NEED_PREPARE_CPUS_FOR_ONE if SMP
    select MT53XX_UP_CHECK if !SMP
    select ARM_HAS_SG_CHAIN
    select ARM_ERRATA_824069
    help
      This enables support for MediaTek MT5886.
config MACH_MT5863
    bool "MediaTek MT5863(Crax Cortex-A53 quad-core)"
    select CPU_V7
    select ARM_GIC
    select HAVE_SMP
    select ARCH_MT5863
    select NEED_PREPARE_CPUS_FOR_ONE if SMP
    select MT53XX_UP_CHECK if !SMP
    select ARM_HAS_SG_CHAIN
    select ARM_ERRATA_824069
    help
      This enables support for MediaTek MT5863.
	  
config MACH_MT5890
	bool "MediaTek MT5890(Oryx Cortex-A12 quad-core)"
	select CPU_V7
	select ARM_GIC
	select HAVE_SMP
	select ARCH_MT5890
	select NEED_PREPARE_CPUS_FOR_ONE if SMP
	select MT53XX_UP_CHECK if !SMP
	select ARM_HAS_SG_CHAIN
	help
	  This enables support for MediaTek MT5890.

config MACH_MT5891
	bool "MediaTek MT5891(Oryx Cortex-A53 quad-core)"
	select CPU_V7
	select ARM_GIC
	select HAVE_SMP
	select ARCH_MT5891
	select NEED_PREPARE_CPUS_FOR_ONE if SMP
	select MT53XX_UP_CHECK if !SMP
	select ARM_HAS_SG_CHAIN
	select ARM_ERRATA_824069
	help
	  This enables support for MediaTek MT5891.

config MACH_MT5893
    bool "MediaTek MT5893(Oryx Cortex-A73 quad-core)"
    select CPU_V7
    select ARM_GIC
    select HAVE_SMP
    select ARCH_MT5893
    select NEED_PREPARE_CPUS_FOR_ONE if SMP
    select MT53XX_UP_CHECK if !SMP
    select ARM_HAS_SG_CHAIN
    select ARM_ERRATA_824069
    select MT53XX_EMI
    help
      This enables support for MediaTek MT5893.

config MACH_MT5861
	bool "MediaTek MT5861(Gazelle Cortex-A12 quad-core)"
	select CPU_V7
	select ARM_GIC
	select HAVE_SMP
        select MIGHT_HAVE_CACHE_L2X0
	select ARCH_MT5861
	select NEED_PREPARE_CPUS_FOR_ONE if SMP
	select MT53XX_UP_CHECK if !SMP
	select ARM_HAS_SG_CHAIN
	help
	  This enables support for MediaTek MT5861.

config MACH_MT5880
	bool "MediaTek MT5880(Viper Cortex-A9)"
	select CPU_V7
	select ARM_GIC
	select HAVE_SMP
        select MIGHT_HAVE_CACHE_L2X0
	select ARCH_MT5880
	select NEED_PREPARE_CPUS_FOR_ONE if SMP
	select MT53XX_UP_CHECK if !SMP
	help
	  This enables support for MediaTek MT5398.

config MACH_MT5881
	bool "MediaTek MT5881(Arm11)"
	select CPU_V6
	select CPU_32v6K
	select ARCH_MT5881
	help
	  This enables support for MediaTek MT5881.

config MACH_MT5882
	bool "MediaTek MT5882(Capri Cortex-A7 quad-core)"
	select CPU_V7
	select ARM_GIC
	select HAVE_SMP
	select ARCH_MT5882
	select NEED_PREPARE_CPUS_FOR_ONE if SMP
	select MT53XX_UP_CHECK if !SMP
	select ARM_HAS_SG_CHAIN
	help
	  This enables support for MediaTek MT5882.

config MACH_MT5865
	bool "MediaTek MT5865(Puppy Cortex-A7 dual-core)"
	select CPU_V7
	select ARM_GIC
	select HAVE_SMP
	select ARCH_MT5865
	select NEED_PREPARE_CPUS_FOR_ONE if SMP
	select MT53XX_UP_CHECK if !SMP
	help
	  This enables support for MediaTek MT5865.

config MACH_MT5368_FPGA
	bool "MediaTek MT5368_FPGA(ARM11)"
	select CPU_V6
	select ARCH_MT5368
	select MT53_FPGA
	help
	  This enables support for MediaTek MT5368.

config MACH_MT5396_FPGA
	bool "MediaTek MT5396_FPGA(ARM11)"
	select CPU_V7
	select ARCH_MT5396
	select MT53_FPGA
	help
	  This enables support for MediaTek MT5396.
endchoice

config ARCH_MT5368
	bool "MediaTek MT5368" if MACH_MT5368 || MACH_MT5368_FPGA
	default n
	select GENERIC_TIME
	select GENERIC_CLOCKEVENTS
	help
	  This enables support for MediaTek MT5368.

config ARCH_MT5396
	bool "MediaTek MT5396" if MACH_MT5396 || MACH_MT5396_FPGA
	default n
	select GENERIC_TIME
	select GENERIC_CLOCKEVENTS
	#select ARCH_USES_GETTIMEOFFSET
	help
	  This enables support for MediaTek MT5396.

config ARCH_MT5389
	bool "MediaTek MT5389" if MACH_MT5389
	default n
	select GENERIC_TIME
	select GENERIC_CLOCKEVENTS
	help
	  This enables support for MediaTek MT5389.

config ARCH_MT5398
	bool "MediaTek MT5398" if MACH_MT5398
	default n
	select GENERIC_TIME
	select GENERIC_CLOCKEVENTS
	select MT53XX_NATIVE_GPIO
	help
	  This enables support for MediaTek MT5398.

config ARCH_MT5399
	bool "MediaTek MT5399" if MACH_MT5399
	default n
	select GENERIC_TIME
	select GENERIC_CLOCKEVENTS
	select HAVE_ARM_SCU if SMP
	select HAVE_ARM_TWD if LOCAL_TIMERS
	select MT53XX_NATIVE_GPIO
	help
	  This enables support for MediaTek MT5399.

config ARCH_MT5886
    bool "MediaTek MT5886" if MACH_MT5886
    default n
    select GENERIC_TIME
    select GENERIC_CLOCKEVENTS
    select HAVE_ARM_ARCH_TIMER if LOCAL_TIMERS
    select MT53XX_NATIVE_GPIO
    select ARCH_HAS_CPUFREQ
    select CLKSRC_MT53XX_TIMER if OF
    help
      This enables support for MediaTek MT5886.
config ARCH_MT5863
    bool "MediaTek MT5863" if MACH_MT5863
    default n
    select GENERIC_TIME
    select GENERIC_CLOCKEVENTS
    select HAVE_ARM_ARCH_TIMER if LOCAL_TIMERS
    select MT53XX_NATIVE_GPIO
    select ARCH_HAS_CPUFREQ
    select CLKSRC_MT53XX_TIMER if OF
    help
      This enables support for MediaTek MT5863.
	  
config ARCH_MT5890
	bool "MediaTek MT5890" if MACH_MT5890
	default n
	select GENERIC_TIME
	select GENERIC_CLOCKEVENTS
	select HAVE_ARM_ARCH_TIMER if LOCAL_TIMERS
	select MT53XX_NATIVE_GPIO
	select ARCH_HAS_CPUFREQ
	select ARM_HAS_SG_CHAIN
	select CLKSRC_MT53XX_TIMER if OF
	help
	  This enables support for MediaTek MT5890.

config ARCH_MT5891
	bool "MediaTek MT5891" if MACH_MT5891
	default n
	select GENERIC_TIME
	select GENERIC_CLOCKEVENTS
	select HAVE_ARM_ARCH_TIMER if LOCAL_TIMERS
	select MT53XX_NATIVE_GPIO
	select ARCH_HAS_CPUFREQ
    select CLKSRC_MT53XX_TIMER if OF
	help
	  This enables support for MediaTek MT5891.

config ARCH_MT5893
    bool "MediaTek MT5893" if MACH_MT5893
    default n
    select GENERIC_TIME
    select GENERIC_CLOCKEVENTS
    select HAVE_ARM_ARCH_TIMER if LOCAL_TIMERS
    select MT53XX_NATIVE_GPIO
    select ARCH_HAS_CPUFREQ
    select CLKSRC_MT53XX_TIMER if OF
    help
      This enables support for MediaTek MT5893.

config ARCH_MT5861
	bool "MediaTek MT5861" if MACH_MT5861
	default n
	select GENERIC_TIME
	select GENERIC_CLOCKEVENTS
	select MT53XX_NATIVE_GPIO
	help
	  This enables support for MediaTek MT5861.

config ARCH_MT5880
	bool "MediaTek MT5880" if MACH_MT5880
	default n
	select GENERIC_TIME
	select GENERIC_CLOCKEVENTS
	select MT53XX_NATIVE_GPIO
	help
	  This enables support for MediaTek MT5880.
config ARCH_MT5881
	bool "MediaTek MT5880" if MACH_MT5881
	default n
	select GENERIC_TIME
	select GENERIC_CLOCKEVENTS
	help
	  This enables support for MediaTek MT5881.

config ARCH_MT5882
	bool "MediaTek MT5882" if MACH_MT5882
	default n
	select GENERIC_TIME
	select GENERIC_CLOCKEVENTS
	select HAVE_ARM_ARCH_TIMER if LOCAL_TIMERS
	select MT53XX_NATIVE_GPIO
	help
	  This enables support for MediaTek MT5882.

config ARCH_MT5865
	bool "MediaTek MT5865" if MACH_MT5865
	default n
	select GENERIC_TIME
	select GENERIC_CLOCKEVENTS
	select HAVE_ARM_ARCH_TIMER if LOCAL_TIMERS
	select MT53XX_NATIVE_GPIO
	help
	  This enables support for MediaTek MT5865.

config MT53XX_BIM_WO_INTR
	bool "MT53XX IC without BIM interrupt controller"
	default n
	help
	  MT53XX new generation chip does not include BIM interrupt controller, 
	  then you need to select this config to have additional module interrupt 
	  clear operations

config MT53_FPGA
	bool "FPGA environment"
	default n

config MT53XX_UP_CHECK
	bool
	default n

config MT53XX_NATIVE_GPIO
	bool
	default n

config MT53XX_USE_CHANNELB_DRAM
	bool "Map channel B DRAM as Linux kernel memory"
	depends on ARCH_MT5396 || ARCH_MT5398 || ARCH_MT5880 || ARCH_MT5399 || ARCH_MT5890 || ARCH_MT5891 || ARCH_MT5886
	default n
	select HIGHMEM
	select ZONE_DMA
	help
	  Map unused channel B DRAM for Linux kernel usage.

config ENABLE_EXCLUSIVE_CACHE
	bool "Enable L1&L2 exclusive cache support"
	depends on CPU_V7 && CACHE_L2X0
	default n if ARCH_MT5396
	help
	  This feature is only supported on CA9 with PL310

endif
config TV_DRV_VFY
	bool "tv drv vfy"

config KMSG_DUMP_EMMC
	bool "support kmsg_dump to eMMC partition"

config MTK_LCA_RAM_OPTIMIZE
	bool "zram enhancement from LCA"

config MT53XX_EMI
	bool "MT53XX external memory interface"
	default n

config RESTORE_CPUSRAM_IN_TZ
	bool "Setup non-boot CPU bringup sram in trustzone"
	default y if ARCH_MT5886 || ARCH_MT5863
config KO_READ_AHEAD    
    bool "enable kernel module read ahead"
    
```

## kernel/linux-3.18/drivers/misc/mediatek/Kconfig
```kconfig
config MEDIATEK_TV_SOLUTION
	bool "MediaTek TV Properitary Configuration"
	#default y if !ARM64
	help
	  Check this to enable MediaTek properity configuration.
config GPUFREQ_MT53xx
	tristate "Mediatek mt53xx GPU freq"
	help
	  This driver supports MT53xx GPU Freq.
```

## kernel/linux-3.18/drivers/net/ethernet/star/Kconfig
```kconfig
#
# MTK network device configuration
#

config NET_VENDOR_MTK
	bool "MTK devices"
	default y
	depends on ETHERNET
	---help---
	  If you have a network (Ethernet) card belonging to this class, say Y
	  and read the Ethernet-HOWTO, available from
	  <http://www.tldp.org/docs.html#howto>.

	  Note that the answer to this question doesn't directly affect the
	  kernel: saying N will just cause the configurator to skip all
	  the questions about Realtek devices. If you say Y, you will be asked for
	  your specific card in the following questions.

if NET_VENDOR_MTK

config MAC5863_MII
	tristate "MT5863 Internal MAC support"
	select MII
	depends on ETHERNET
	help
	  This is a driver for MT5863's internal Ethernet mac,
	  Say Y if you want it compiled into the kernel.

	  This driver is also available as a module ( = code which can be
	  inserted in and removed from the running kernel whenever you want).
	  The module will be called mmac.  If you want to compile it as a
	  module, say M here and read <file:Documentation/modules.txt> as well
	  as <file:Documentation/networking/net-modules.txt>.

config MAC5865_MII
    tristate "MT5865 Internal MAC support"
    select MII
    depends on ETHERNET
    help
      This is a driver for MT5865's internal Ethernet mac,
      Say Y if you want it compiled into the kernel.

      This driver is also available as a module ( = code which can be
      inserted in and removed from the running kernel whenever you want).
      The module will be called mmac.  If you want to compile it as a
      module, say M here and read <file:Documentation/modules.txt> as well
      as <file:Documentation/networking/net-modules.txt>.

config MAC5886_MII
	tristate "MT5886 Internal MAC support"
	select MII
	depends on ETHERNET
	help
	  This is a driver for MT5886's internal Ethernet mac,
	  Say Y if you want it compiled into the kernel.

	  This driver is also available as a module ( = code which can be
	  inserted in and removed from the running kernel whenever you want).
	  The module will be called mmac.  If you want to compile it as a
	  module, say M here and read <file:Documentation/modules.txt> as well
	  as <file:Documentation/networking/net-modules.txt>.

config MAC5893_MII
	tristate "MT5893 Internal MAC support"
	select MII
	depends on ETHERNET
	help
	  This is a driver for MT5893's internal Ethernet mac,
	  Say Y if you want it compiled into the kernel.

	  This driver is also available as a module ( = code which can be
	  inserted in and removed from the running kernel whenever you want).
	  The module will be called mmac.  If you want to compile it as a
	  module, say M here and read <file:Documentation/modules.txt> as well
	  as <file:Documentation/networking/net-modules.txt>.
endif # NET_VENDOR_MTK
```

## kernel/linux-3.18/drivers/soc/Kconfig
```kconfig
menu "SOC (System On Chip) specific Drivers"

source "drivers/soc/qcom/Kconfig"
source "drivers/soc/ti/Kconfig"
source "drivers/soc/versatile/Kconfig"
if ARM64
source "drivers/soc/mediatek/Kconfig"
endif
if !ARM64
source "drivers/soc/mediatek/Kconfig-32"
endif
source "drivers/soc/mediatek/gpu/gpu_mali/gator/Kconfig.mtk"

endmenu
```

## kernel/linux-3.18/drivers/soc/mediatek/gpu/gpu_mali/gator/Kconfig.mtk
```kconfig
config GATOR
	tristate "Gator module for ARM's Streamline Performance Analyzer"
	help
	  Gator module for ARM's Streamline Performance Analyzer
```

## kernel/linux-3.18/drivers/usb/mtu3/Kconfig
```kconfig
# For MTK USB3.0 IP

config USB_MTU3
	tristate "MediaTek USB3 gadget controller"
	depends on (USB || USB_GADGET) && HAS_DMA

	help
	  Say Y or M here if your system runs on MediaTek SoCs with
	  Dual Role SuperSpeed USB controller. You can select usb
	  mode as peripheral role or host role, or both.

	  If you don't know what this is, please say N.

	  Choose M here to compile this driver as a module, and it
	  will be called mtu3.ko.


if USB_MTU3
choice
	bool "MTU3 Mode Selection"

	default y

config USB_MTU3_GADGET
	bool "Gadget only mode"
	depends on USB_GADGET=y || USB_GADGET=USB_MTU3
	help
	  Select this when you want to use MTU3 in gadget mode only,
	  thereby the host feature will be regressed.

endchoice

config USB_MTU3_DEBUG
	bool "Enable Debugging Messages"
	default y
	help
	  Say Y here to enable debugging messages in the MTU3 Driver.

endif
```

## kernel/linux-3.18/drivers/usb/mu3h/Kconfig
```kconfig
config USB_MU3H
	tristate "MU3H (MTK USB3.0 Host) Controller"
	depends on USB

	  
choice 
	depends on USB_MU3H
	bool "MTK USB3.0 Host Drivers"
	default USB_MU3H_DRV
	
config USB_MU3H_DRV
	bool "MU3H Driver"
config USB_MU3H_TEST_DRV
	bool "MU3H Test Driver"
	
endchoice

config XHCI_DEV_NOTE
    tristate "xHCI HCD with device notification function (patch to usb core)"
    depends on USB_MU3H
config XHCI_PM
    tristate "xHCI HCD with u2/u3 LPM function (patch to usb core)"
    depends on USB_MU3H
config USB_XHCI_DEBUGGING
    bool "Debugging for xHCI host controller"
    depends on USB_MU3H
```
